## CMakeLists.txt
```
#
# Copyright (c) 2018 Nordic Semiconductor
#
# SPDX-License-Identifier: LicenseRef-Nordic-5-Clause
#
cmake_minimum_required(VERSION 3.20.0)

list(APPEND BOARD_ROOT ${CMAKE_CURRENT_SOURCE_DIR}/boards)
set(PM_STATIC_YML_FILE ${CMAKE_CURRENT_SOURCE_DIR}/pm_static.yml)
find_package(Zephyr REQUIRED HINTS $ENV{ZEPHYR_BASE})
project(NONE)

# NORDIC SDK APP START
target_sources(app PRIVATE
  src/main.c
  src/spi.c
  src/cc1101radio.c
  src/cmdhandler.c
  src/audio.c
  src/charger.c
  src/wlgpio.c
)


# NORDIC SDK APP END

zephyr_library_include_directories(.)
```

## prj.conf
```kconfig
#
# Copyright (c) 2018 Nordic Semiconductor
#
# SPDX-License-Identifier: LicenseRef-Nordic-5-Clause
#



# Enable the UART driver
CONFIG_UART_ASYNC_API=y

CONFIG_SERIAL=y
CONFIG_UART_INTERRUPT_DRIVEN=y

CONFIG_GPIO=y
CONFIG_SPI=y

# Make sure printk is printing to the UART console
CONFIG_CONSOLE=y
CONFIG_UART_CONSOLE=y

#2048
CONFIG_HEAP_MEM_POOL_SIZE=4096 

CONFIG_MAIN_STACK_SIZE=16384

CONFIG_BT=y
CONFIG_BT_PERIPHERAL=y
CONFIG_BT_DEVICE_NAME="COSMIIC Wireless Link"
#If we want to change the device name at runtime uncomment next line.  
#CONFIG_BT_DEVICE_NAME_DYNAMIC=y 
CONFIG_BT_DEVICE_APPEARANCE=833
CONFIG_BT_MAX_CONN=1
CONFIG_BT_MAX_PAIRED=5

# Enable the NUS service
CONFIG_BT_NUS=y
CONFIG_BT_NUS_SECURITY_ENABLED=y
CONFIG_BT_NUS_AUTHEN=y

# Enable bonding (change all back to y)
CONFIG_BT_SETTINGS=y
CONFIG_FLASH=y
CONFIG_FLASH_PAGE_LAYOUT=y
CONFIG_FLASH_MAP=y
CONFIG_NVS=y
CONFIG_SETTINGS=y
CONFIG_SETTINGS_NVS=y


CONFIG_BT_SMP=y

# Configs for directed advertising
CONFIG_BT_FILTER_ACCEPT_LIST=y
CONFIG_BT_PRIVACY=y

# from BLE FUndamentals Lesson3, Ex2 Defauls: 24, 40, 0, 42
CONFIG_BT_PERIPHERAL_PREF_MIN_INT=6
CONFIG_BT_PERIPHERAL_PREF_MAX_INT=20
CONFIG_BT_PERIPHERAL_PREF_LATENCY=0
CONFIG_BT_PERIPHERAL_PREF_TIMEOUT=42
CONFIG_BT_GAP_AUTO_UPDATE_CONN_PARAMS=y

CONFIG_BT_GATT_CLIENT=y
CONFIG_BT_USER_DATA_LEN_UPDATE=y
CONFIG_BT_BUF_ACL_RX_SIZE=251
CONFIG_BT_BUF_ACL_TX_SIZE=251
CONFIG_BT_L2CAP_TX_MTU=251

# Enable DK LED and Buttons library
CONFIG_DK_LIBRARY=y

# This example requires more workqueue stack
CONFIG_SYSTEM_WORKQUEUE_STACK_SIZE=8192 
#2048

# Config logger
CONFIG_LOG=y

#JML added
CONFIG_LOG_MODE_IMMEDIATE=n

CONFIG_LOG_BUFFER_SIZE=4096 
CONFIG_USE_SEGGER_RTT=y
CONFIG_LOG_BACKEND_RTT=y
CONFIG_LOG_BACKEND_UART=n
CONFIG_LOG_PRINTK=n

CONFIG_LOG_MODE_OVERFLOW=y
CONFIG_LOG_MODE_DEFERRED=y
CONFIG_LOG_PROCESS_THREAD_STACK_SIZE=4096


CONFIG_ASSERT=y
#CONFIG_LOG_DEFAULT_LEVEL=4

#CONFIG_SENSOR=y
#CONFIG_ISM330IS=y  


#Fanstel board doesn't include NOR FLASH 
CONFIG_SPI_NOR=n
#Disabled low power
CONFIG_NRF_WIFI_LOW_POWER=n

CONFIG_PWM=y

CONFIG_LOG_SPEED=y

#JML: i don't think this is used because we handle the timeouts manually in app
CONFIG_BT_LIM_ADV_TIMEOUT=60
CONFIG_BT_RX_STACK_SIZE=4096

CONFIG_POWEROFF=y
CONFIG_ADC=y
CONFIG_I2C=y

#CONFIG_NFCT_PINS_AS_GPIOS=y

##CONFIG_BOOTLOADER_MCUBOOT=y  ##now done with sysbuild

#SD CARD
CONFIG_DISK_ACCESS=y
CONFIG_FILE_SYSTEM=y
CONFIG_FAT_FILESYSTEM_ELM=y
CONFIG_DISK_DRIVER_SDMMC=y
CONFIG_FS_FATFS_LFN=y
CONFIG_FS_FATFS_MOUNT_MKFS=y
CONFIG_FS_FATFS_LFN_MODE_HEAP=y

CONFIG_WATCHDOG=y
CONFIG_WDT_DISABLE_AT_BOOT=y



#JML Added for Coil UART
CONFIG_UART_NRFX=y
CONFIG_NRFX_UARTE3=y
CONFIG_UART_3_INTERRUPT_DRIVEN=n
CONFIG_UART_3_ASYNC=y

#JML added for debugging
CONFIG_DEBUG_OPTIMIZATIONS=y
CONFIG_DEBUG_THREAD_INFO=y
```

## src/cc1101radio.h
```c
// Doxygen
/*! 
** @defgroup radio Radio Interface
** @ingroup radiomanagement
*/
/*!
** @file   cc1101.h
** @author Hardway
** @date   12/14/2009
**
** @brief State machine for taking incoming packets from the radio and 
** either reading or writing to the local Object Dictionary or routing 
** to the CAN network. The corresponding replies are returned to the source.
**
** @ingroup radio
*/    
#ifndef _CC1101_RADIO_H
#define _CC1101_RADIO_H

#include <stdint.h>
#include <stdlib.h>
#include <stdbool.h>
#include <string.h>


extern struct k_msgq imp_resp_msgq;
extern struct k_msgq imp_req_msgq;
extern struct k_sem medradio_init_ok;
extern struct k_sem medradio_sent;
extern struct k_sem medradio_req_resp;

//JML: does this need the __aligned(4) attribute
struct medRadio_type {
   	uint8_t buf[64]; //must be divisible by 4
	uint8_t len;
	uint8_t source;
	uint8_t unused2;
	uint8_t unused3;
};






// -------- PROTOTYPES ----------
void initRadioConfig( void );
void sendRadioPacket(const uint8_t *data, uint8_t dataLen );
uint8_t getRadioPacket( uint8_t *data );
uint8_t clearChannelSearch(uint8_t dwell, int8_t* maxRSSI, int8_t* avgRSSI);
void loadRadioSettingsFromFlash(void);
void loadRadioSettingsForPMBoot(void);
uint32_t getTaskTimeoutForMedRadio(void);
void idleMedRadio(void);
void powerDownRadio(void);
uint16_t getMedRadioTimeout( void );
void copyRadioSettings(uint8_t* buf);
bool updateMedRadioLocalAddress(uint8_t val);
bool updateMedRadioRemoteAddress(uint8_t val);
bool updateMedRadioChannel(uint8_t val);
bool updateMedRadioTXPower(uint8_t val);
bool updateMedRadioRXTimeout(uint8_t val);
bool updateMedRadioWORInterval(uint8_t val);
bool updateMedRadioRetries(uint8_t val);
bool updateMedRadioEncryption(uint8_t val);
bool updateMedRadioSessionTime(uint8_t val);
bool updateMedRadioMaintain(uint8_t val);

uint16_t getTimeRemainingInSession(); //in ms

int saved_settings_write(uint16_t id, const void* buf, size_t len);
int saved_settings_read(uint16_t id, const void* buf, size_t len);

void radio_interrupt(void);

void enableEncryption(bool en);
int8_t getLastRSSI(void);

void btea(uint32_t *v, int n, uint32_t const key[4]);




#endif
 
```

## src/charger.h
```c
#ifndef _CHARGER_H
#define _CHARGER_H


#include <stdint.h>
#include <stdlib.h>
#include <stdbool.h>
#include <string.h>

void charger_thread(void);
void coil_reqresp_thread(void);

#define ROUTE_BLE   1
#define ROUTE_UART  2
#define ROUTE_USB   3
#define ROUTE_LOCAL 4


#define ROUTE_BIT_PMBOOT_WRITE   0x80
#define ROUTE_BIT_PMBOOT_READ    0x40
#define ROUTE_BIT_PMSCRIPT_WRITE 0x20
#define ROUTE_BIT_PMSCRIPT_READ  0x10
#define ROUTE_BIT_PMFILE_READ    0x08

#define CHARGER_MODE_NONE	0
#define CHARGER_MODE_CLOCK	1
#define CHARGER_MODE_CHARGE	2
#define CHARGER_MODE_TUNE	3
#define CHARGER_MODE_DETECT	4
#define CHARGER_MODE_POWERDOWN	5
#define CHARGER_MODE_CHARGE_NOFEEDBACK	6
#define CHARGER_MODE_DISPLAY_PASSKEY	7
#define CHARGER_MODE_DISPLAY_ERASEBONDS	8
#define CHARGER_MODE_MAX    8  
#define CHARGER_MODE_DEFAULT CHARGER_MODE_CLOCK

extern struct k_msgq coil_resp_msgq;
extern struct k_msgq coil_req_msgq;

extern struct k_msgq charger_resp_msgq;

struct smartCoil_type {
   	uint8_t buf[64]; //must be divisible by 4
	uint8_t len;
	uint8_t source;
	uint8_t unused2;
	uint8_t unused3;
};


void OutputDisplay(bool clear, char* str1, char* str2, char* str3, char* str4, uint8_t len1, uint8_t len2, uint8_t len3, uint8_t len4);
bool OutputDisplayLine(uint8_t line, char* str, uint8_t len);
void readRTC(uint8_t* rtc);
void writeRTC(uint8_t* rtc);

void startDCDC();
void stopDCDC();
void setDCDC(uint16_t voltage);
void keepCoilOn();
uint32_t setCoilPeriod(uint32_t period);
uint32_t getCoilPeriod(void);
uint16_t getThermistor(void);
uint8_t getCDPower(int16_t* current, uint16_t* voltage);
uint8_t getSysPower(int16_t* current, uint16_t* voltage);


bool logToFile(char * data, uint8_t len);
bool readFromFile(char * data, uint8_t len,  uint32_t off);
void initSD(void);
void dirSD(void);
uint32_t getLogLength(void);
bool flushLog(void);

uint8_t getChargeMode(void);
uint8_t setChargeMode(uint8_t mode);

void tuneCoil(void);
void metalDetect(void);
void charge(void);
void powerDownPM(void);

#define UPDATE_COIL   0
#define TURN_ON_COIL  1
#define TURN_OFF_COIL 2


void testNMT(void);
void testReadSDO(void);
void testWriteSDO(void);
uint8_t ReadSDO(uint8_t node, uint16_t index, uint8_t subindex, uint8_t numSubIndices, uint8_t* resp);
uint8_t WriteSDO(uint8_t node, uint16_t index, uint8_t subindex, uint8_t numSubIndices, uint8_t* writeData, uint8_t sizeBytes);
uint8_t NMT(uint8_t node, uint8_t cmd, uint8_t param1, uint8_t param2);
int8_t transmit(uint8_t node, uint8_t* data, uint8_t len, uint8_t counter, uint8_t protocol, uint8_t* resp);
uint8_t getChargerParams(uint8_t* settings);
void setChargerParams(uint8_t* settings);
uint8_t getAppRadioFromPMBoot(uint8_t* addrAP, uint8_t* addrPM, uint8_t* chan, uint8_t* power);
bool getBatteryAverages(uint16_t *vAvg, int16_t *iAvg, uint16_t v1, uint16_t v2, uint16_t v3, int16_t i1, int16_t i2, int16_t i3);
#endif
```

## src/cmdhandler.h
```c
#ifndef _CMD_HANDLER_H
#define _CMD_HANDLER_H

#include <stdint.h>
#include <stdlib.h>
#include <stdbool.h>
#include <string.h>

#define WL_IN_CHARGER true
#define HW_REV 1 //up to 65535
#define SW_REV 19 //up to 65535

#define PKT_HEADER_LEN 3
#define MIN_PKT_LEN PKT_HEADER_LEN // when checksum added, this will change
#define MAX_PKT_LEN  RX_BUF_SIZE
#define PKT_LEN_UNDEFINED 0 
#define MAX_MEDRADIO_PAYLOAD 60 //+ 64-length byte, address byte, 2 CRC/LQI bytes
#define MIN_MEDRADIO_PAYLOAD 0 //


//JML: does this need the __aligned(4) attribute
struct cmdHandler_type {
   	uint8_t buf[256]; //must be divisible by 4
	uint8_t len;
	uint8_t route;
	uint8_t unused2;
	uint8_t unused3;
};

extern struct k_msgq cmd_resp_msgq;

#define ROUTE_BLE   1
#define ROUTE_UART  2
#define ROUTE_USB   3
#define ROUTE_LOCAL 4
#define ROUTE_CHARGER 5

#define SOURCE_CMDHANDLER 1 //includes programmed button/accel actions + USB/BLE
#define SOURCE_CHARGER	  2
#define SOURCE_SENSOR	  3 //JML TODO:remove this eventually

struct action_type {
   	uint8_t buf[60]; 
	uint8_t len;
	uint8_t source;
};

// struct pmboot_header {
//    	uint32_t addr; 
// 	uint16_t pgsize;
// 	uint8_t sector;
// 	uint8_t unused;
// };

#define BUTTON_1_SHORT 0
#define BUTTON_2_SHORT 1
#define BUTTON_1_LONG  2
#define BUTTON_2_LONG  3
//#define ACCELEROMETER  4
#define MAX_ACTIONS    4
extern struct action_type action[MAX_ACTIONS];

#define RADIO_SETTINGS_ID 1
#define ACTION_SETTINGS_ID 2 
#define COIL_SETTINGS_ID   2 + MAX_ACTIONS


extern struct k_msgq cmd_req_msgq;

#define BIT0 0x01
#define BIT1 0x02
#define BIT2 0x04
#define BIT3 0x08
#define BIT4 0x10
#define BIT5 0x20
#define BIT6 0x40
#define BIT7 0x80

#define BLUE_LED_BLE_ADV         BIT0
#define GREEN_LED_RADIO_RESPONSE BIT1
#define RED_LED_RADIO_ERROR		 BIT2
#define LED_CHARGER				 BIT3
#define WHITE_LED_USB  			 BIT4
#define LED_MANUAL				 BIT6
#define LED_AUDIO_OFF  		 	 BIT7

#define LED_DEFAULT_MODE_WL		 BIT0|BIT1|BIT2|BIT4
#define LED_DEFAULT_MODE_CHARGER BIT3  //|BIT7

extern uint8_t modeLED;

#define RESP_INVALID_PARAMETERS 0x0B
#define RESP_MEDRADIO_TIMEOUT   0x0D
#define RESP_COIL_TIMEOUT	    0x0E
#define RESP_SUCCESS            0x06

#define RESP_LOCAL_PMBOOT_WRITE 0x81
#define RESP_LOCAL_PMBOOT_READ  0x82
#define RESP_LOCAL_PMFILE_READ  0x83

#define INDEX_RESP_SYNC        0 
#define INDEX_RESP_TYPE        1 
#define INDEX_RESP_LEN         2    
#define INDEX_RESP_PAYLOAD     3
#define NON_PAYLOAD_RESP_BYTES 3

#define MAX_CMD_RESPONSE_LEN 255
#define MIN_CMD_RESPONSE_LEN NON_PAYLOAD_RESP_BYTES 
#define AWAITING_RESPONSE   1 

#define INDEX_CMD_SYNC        0 
#define INDEX_CMD_COMMAND     1
#define INDEX_CMD_LEN         2
#define INDEX_CMD_PAYLOAD     3
#define NON_PAYLOAD_CMD_BYTES 3

#define BLE_MODE_READY       4
#define BLE_MODE_OPEN_ADVERT 3
#define BLE_MODE_ADVERT      2
#define BLE_MODE_CONNECTING  1
#define BLE_MODE_NONE        0

#define SYNC_BYTE  0xFF

#define MSG_DEPTH 1

void command_handler(uint8_t *packet, uint8_t len, uint8_t route);
void uart_send(uint8_t* packet, uint8_t len);
void ble_send(uint8_t* packet, uint8_t len);

void setLowPower(void);

uint16_t setBuzzerPeriod(uint16_t period, uint16_t timeon);
void ble_start_advertising(void);
void ble_stop_advertising(void);
void power_down_sensor(void);
int16_t get_adc_sample(void);

uint8_t pmboot_write_supervisor(uint8_t *pmboot, uint8_t * resp, uint8_t resp_len, uint8_t * req, uint8_t * req_len);
uint8_t pmboot_read_supervisor(uint8_t *pmboot, uint8_t * resp, uint8_t resp_len, uint8_t * req, uint8_t * req_len);
uint8_t pmfile_read_supervisor(uint8_t *pmboot, uint8_t * resp, uint8_t resp_len, uint8_t * req, uint8_t * req_len);

void resetWL(void);
void setLEDs( uint8_t red, uint8_t green, uint8_t blue);

//void enable_sensor(uint8_t enable);

uint8_t erasebonds(void);
void ble_start_advertising_pairing_mode(void);
uint32_t getpasskey(void);
uint8_t get_bonded_devices(uint8_t *buf);

uint8_t getBLEMode(void);
#endif
```

## src/wlgpio.c
```c
#include <zephyr/drivers/gpio.h>
#include "wlgpio.h"
#include "cc1101radio.h"

#include <zephyr/logging/log.h>
#include <dk_buttons_and_leds.h>
#include <zephyr/kernel.h> //for k_msleep
#include <zephyr/device.h>
#include <zephyr/devicetree.h>
#include <zephyr/drivers/uart.h>


#define LOG_MODULE_NAME wlgpio
LOG_MODULE_REGISTER(LOG_MODULE_NAME);


/*Port0*/
#define WL0PIN_DCDC_EN     2 
#define WL0PIN_RST_DISP    3 
#define WL0PIN_GDO0        6 
#define WL0PIN_BUZZ_EN     7
#define WL0PIN_BUCK_EN     12
#define WL0PIN_GDO2        19 
#define WL0PIN_WIFI_EN     31

/*Port1*/
#define WL1PIN_3V3_EN   0
#define WL1PIN_DEBUG0   4
#define WL1PIN_DEBUG1   5
#define WL1PIN_CD_EN    6
#define WL1PIN_PG       9
#define WL1PIN_STAT2    10
#define WL1PIN_STAT1    11
#define WL1PIN_IMUINT   12



static const struct device *gpiodev0 = DEVICE_DT_GET(DT_NODELABEL(gpio0));
static const struct device *gpiodev1 = DEVICE_DT_GET(DT_NODELABEL(gpio1));

/*Define a variable of type static struct gpio_callback */
static struct gpio_callback radio_int_cb_data;

//NEW
/*Define the callback function */
void radio_int_cb(const struct device *dev, struct gpio_callback *cb, uint32_t pins)
{
	radio_interrupt();
}

void init_wl_gpio(void)
{
    int err;

    if (!device_is_ready(gpiodev0)) {
		LOG_ERR("GPIOdev0 device not available");
	}
    if (!device_is_ready(gpiodev1)) {
		LOG_ERR("GPIOdev1 device not available");
	}

    //Charging Status inputs
	/* Configure the interrupt on the button's pin falling edge */
	err = gpio_pin_configure(gpiodev1, WL1PIN_PG, GPIO_INPUT | GPIO_PULL_UP );
	if (err) {
		LOG_ERR("Cannot configure WL1PIN_PG as input (err: %d)", err);
	}
	err = gpio_pin_configure(gpiodev1, WL1PIN_STAT2 , GPIO_INPUT | GPIO_PULL_UP );
	if (err) {
		LOG_ERR("Cannot configure WL1PIN_STAT2 as input (err: %d)", err);
	}
	err = gpio_pin_configure(gpiodev1, WL1PIN_STAT1, GPIO_INPUT | GPIO_PULL_UP );
	if (err) {
		LOG_ERR("Cannot configure GPIO1.11 as input (err: %d)", err);
	}

	//ISM330IS interrupt lines 
	err = gpio_pin_configure(gpiodev1, WL1PIN_IMUINT, GPIO_INPUT  );
	if (err) {
		LOG_ERR("Cannot configure  WL1PIN_IMUINT as input (err: %d)", err);
	}
	
    //3V3_LED ENABLE
	err = gpio_pin_configure(gpiodev1, WL1PIN_3V3_EN, GPIO_OUTPUT_ACTIVE );
	if (err) {
		LOG_ERR("Cannot configure WL1PIN_3V3_EN as output (err: %d)", err);
	}

	//CoilDrive ENABLE
	err = gpio_pin_configure(gpiodev1, WL1PIN_CD_EN, GPIO_OUTPUT_INACTIVE );
	if (err) {
		LOG_ERR("Cannot configure WL1PIN_CD_EN as output (err: %d)", err);
	}

	err = gpio_pin_configure(gpiodev1, WL1PIN_DEBUG0, GPIO_OUTPUT_INACTIVE );
	if (err) {
		LOG_ERR("Cannot configure WL1PIN_DEBUG0 as output (err: %d)", err);
	}
	
	err = gpio_pin_configure(gpiodev1, WL1PIN_DEBUG1, GPIO_OUTPUT_INACTIVE );
	if (err) {
		LOG_ERR("Cannot configure WL1PIN_DEBUG1 as output (err: %d)", err);
	}

    /* This has a big impact on current consumption when operating at 3.3V */
	err = gpio_pin_configure(gpiodev0, WL0PIN_WIFI_EN, GPIO_OUTPUT_INACTIVE );
	if (err) {
		LOG_ERR("Cannot configure WL0PIN_WIFI_EN as output (err: %d)", err);
	}

	/* P0.7 low to turn off buzzer enable*/
	err = gpio_pin_configure(gpiodev0, WL0PIN_BUZZ_EN, GPIO_OUTPUT_INACTIVE );
	if (err) {
		LOG_ERR("Cannot configure WL0PIN_BUZZ_EN as output (err: %d)", err);
	}

	/* P0.3 (nRESET) high to use LCD Display */
	err = gpio_pin_configure(gpiodev0, WL0PIN_RST_DISP, GPIO_OUTPUT_INACTIVE );
	
	if (err) {
		LOG_ERR("Cannot configure WL0PIN_RST_DISP as output low (err: %d)", err);
	}


	err = gpio_pin_configure(gpiodev0, WL0PIN_DCDC_EN, GPIO_OUTPUT_INACTIVE );
	
	if (err) {
		LOG_ERR("Cannot configure WL0PIN_DCDC_EN as output low (err: %d)", err);
	}
	enableDCDC(1);

    //CC1101Radio configure inputs and interrupts
    err = gpio_pin_configure(gpiodev0, WL0PIN_GDO0, GPIO_INPUT );
	
	if (err) {
		LOG_ERR("Cannot configure WL0PIN_GDO0 as input (err: %d)", err);
	}

	
	err = gpio_pin_configure(gpiodev0, WL0PIN_GDO2, GPIO_INPUT);
	
	if (err) {
		LOG_ERR("Cannot configure WL0PIN_GDO2 as input (err: %d)", err);
		return;
	}

}

void configureRadioInterrupt(void)
{
    int err; 
    /* Configure the interrupt on the falling edge */
	err = gpio_pin_interrupt_configure(gpiodev0, WL0PIN_GDO0, GPIO_INT_EDGE_TO_INACTIVE);
    if (err) {
        LOG_ERR("Cannot configure WL0PIN_GDO0 interrupt (err: %d)", err);
        return;
    }
	
    gpio_init_callback(&radio_int_cb_data, radio_int_cb, BIT(WL0PIN_GDO0)); 	
	gpio_add_callback(gpiodev0, &radio_int_cb_data);

	/* Initialize the work item to allow offloadin*/
	//k_work_init(&isr_work.work, isr_offload_function);	
}

//enables #V# LDO required to use LEDs and Audio Buzzer
void enable3V3(bool enable){
	gpio_pin_set(gpiodev1, WL1PIN_3V3_EN, enable);
}

void enableWiFi(bool enable){
	gpio_pin_set(gpiodev0, WL0PIN_WIFI_EN , enable);
}

void enableDCDC(bool enable){
	gpio_pin_set(gpiodev0, WL0PIN_DCDC_EN, enable);
}

void enableDisplay(bool enable){
	gpio_pin_set(gpiodev0, WL0PIN_RST_DISP, enable);
}

void enableCoilDrive(bool enable){
	gpio_pin_set(gpiodev1, WL1PIN_CD_EN, enable );
}

void enableDebug0(bool enable){
	gpio_pin_set(gpiodev1, WL1PIN_DEBUG0, enable );
}

void enableDebug1(bool enable){
	gpio_pin_set(gpiodev1, WL1PIN_DEBUG1, enable );
}

//Charging status returns 0 when true, 1 when false 
//0b111 running off battery
//0b100 running off USB, charging
//0b010 running off USB, done charging (or no battery)
uint8_t getChargingStatus(void)
{
	int val;
	uint8_t stat = 0;

	val = gpio_pin_get(gpiodev1, WL1PIN_PG ); //PG
	if (val<0) {
		LOG_ERR("Cannot read GPIO1.09 (PG) (err: %d)", val);
		return 0xF1;
	} else {
		stat |= val;
	}
	val = gpio_pin_get(gpiodev1, WL1PIN_STAT1 ); //STAT1
	if (val<0) {
		LOG_ERR("Cannot read GPIO1.11 (STAT1) (err: %d)", val);
		return 0xF2;
	} else {
		stat |= (val<<1);
	}

	val = gpio_pin_get(gpiodev1, WL1PIN_STAT2 ); //STAT2
	if (val<0) {
		LOG_ERR("Cannot read GPIO1.10 (STAT2) (err: %d)", val);
		return 0xF3;
	} else {
		stat |= (val<<2);
	}
	return stat;
}
```
